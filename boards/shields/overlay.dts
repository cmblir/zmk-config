/dts-v1/;

/ {
    chosen {
        zmk,display = &ssd1306;
    };

    &i2c1 {
        status = "okay";
        ssd1306: ssd1306@3c {
            compatible = "solomon,ssd1306fb-i2c";
            reg = <0x3c>;
            width = <128>;
            height = <32>;
            segment-offset = <0>;
            page-offset = <0>;
            display-offset = <0>;
            multiplex-ratio = <31>;
            reset-gpios = <&gpio0 8 GPIO_ACTIVE_LOW>;
            vbat-gpios = <&gpio0 9 GPIO_ACTIVE_LOW>;
        };
    };
};
